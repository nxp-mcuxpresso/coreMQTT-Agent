## Kconfig
```kconfig
#
# Copyright 2024-2026 NXP
#
# SPDX-License-Identifier: BSD-3-Clause
#

menuconfig MCUX_COMPONENT_middleware.freertos.coremqtt-agent
    bool "coremqtt-agent"
    default n
    help
        Agent for thread-safe use of coreMQTT
    select MCUX_COMPONENT_middleware.freertos.coremqtt
    select MCUX_COMPONENT_middleware.iot_reference.logging
```
